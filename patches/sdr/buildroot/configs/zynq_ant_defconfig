## patches/sdr/buildroot/configs/zynq_ant_defconfig
```kconfig
BR2_arm=y
BR2_cortex_a9=y
BR2_ARM_ENABLE_NEON=y
BR2_ARM_ENABLE_VFP=y
BR2_ARM_FPU_NEON=y
BR2_TOOLCHAIN_EXTERNAL=y
BR2_TOOLCHAIN_EXTERNAL_CUSTOM=y
BR2_TOOLCHAIN_EXTERNAL_CUSTOM_PREFIX="arm-linux-gnueabihf"
BR2_TOOLCHAIN_EXTERNAL_GCC_8=y
BR2_TOOLCHAIN_EXTERNAL_HEADERS_4_14=y
BR2_TOOLCHAIN_EXTERNAL_CUSTOM_GLIBC=y
BR2_TOOLCHAIN_EXTERNAL_CXX=y
BR2_TARGET_GENERIC_HOSTNAME="ant"
BR2_TARGET_GENERIC_ISSUE="Welcome to ANTSDR"
BR2_ROOTFS_DEVICE_CREATION_DYNAMIC_MDEV=y
BR2_TARGET_GENERIC_ROOT_PASSWD="analog"
BR2_TARGET_GENERIC_GETTY_PORT="ttyPS0"
BR2_ROOTFS_POST_BUILD_SCRIPT="board/ant/post-build.sh"
BR2_PACKAGE_MTD=y
# BR2_PACKAGE_MTD_NANDDUMP is not set
# BR2_PACKAGE_MTD_NANDTEST is not set
# BR2_PACKAGE_MTD_NANDWRITE is not set
# BR2_PACKAGE_MTD_UBIATTACH is not set
# BR2_PACKAGE_MTD_UBICRC32 is not set
# BR2_PACKAGE_MTD_UBIDETACH is not set
# BR2_PACKAGE_MTD_UBIFORMAT is not set
# BR2_PACKAGE_MTD_UBIMKVOL is not set
# BR2_PACKAGE_MTD_UBINFO is not set
# BR2_PACKAGE_MTD_UBINIZE is not set
# BR2_PACKAGE_MTD_UBIRENAME is not set
# BR2_PACKAGE_MTD_UBIRMVOL is not set
# BR2_PACKAGE_MTD_UBIRSVOL is not set
# BR2_PACKAGE_MTD_UBIUPDATEVOL is not set
# BR2_PACKAGE_MTD_UBIBLOCK is not set
BR2_PACKAGE_LINUX_FIRMWARE=y
BR2_PACKAGE_LINUX_FIRMWARE_RALINK_RT61=y
BR2_PACKAGE_LINUX_FIRMWARE_RALINK_RT73=y
BR2_PACKAGE_LINUX_FIRMWARE_RALINK_RT2XX=y
BR2_PACKAGE_LINUX_FIRMWARE_RTL_81XX=y
BR2_PACKAGE_LINUX_FIRMWARE_RTL_87XX=y
BR2_PACKAGE_LINUX_FIRMWARE_RTL_88XX=y
BR2_PACKAGE_INPUT_EVENT_DAEMON=y
BR2_PACKAGE_UBOOT_TOOLS=y
BR2_PACKAGE_ZLIB=y
BR2_PACKAGE_HOST_ZSTD=y
BR2_PACKAGE_LIBAD9361_IIO=y
BR2_PACKAGE_LIBIIO_IIOD_USBD=y
BR2_PACKAGE_LIBIIO_TESTS=y
BR2_PACKAGE_LIBINI=y
BR2_PACKAGE_AVAHI=y
BR2_PACKAGE_AVAHI_DAEMON=y
BR2_PACKAGE_AVAHI_LIBDNSSD_COMPATIBILITY=y
BR2_PACKAGE_DROPBEAR=y
BR2_PACKAGE_DROPBEAR_LOCALOPTIONS_FILE="board/pluto/dropbrear_localoptions.h"
BR2_PACKAGE_IW=y
BR2_PACKAGE_WPA_SUPPLICANT=y
BR2_PACKAGE_WPA_SUPPLICANT_CLI=y
BR2_PACKAGE_WPA_SUPPLICANT_PASSPHRASE=y
BR2_PACKAGE_POLL_SYSFS=y
BR2_PACKAGE_AD936X_REF_CAL=y
BR2_TARGET_ROOTFS_CPIO=y
BR2_TARGET_ROOTFS_CPIO_GZIP=y
BR2_TARGET_ROOTFS_CPIO_UIMAGE=y
BR2_PACKAGE_HOST_DOSFSTOOLS=y
BR2_PACKAGE_HOST_GENIMAGE=y
BR2_PACKAGE_HOST_MTOOLS=y

BR2_PACKAGE_AD9361=y
BR2_PACKAGE_PYTHON3=y
BR2_PACKAGE_PYTHON_SSL=y
BR2_PACKAGE_PYTHON_MAKO=y
BR2_PACKAGE_PYTHON_NUMPY_ARCH_SUPPORTS=y
BR2_PACKAGE_PYTHON_NUMPY=y
BR2_PACKAGE_PYTHON_PACKAGING=y
BR2_PACKAGE_PYTHON_PIP=y
BR2_PACKAGE_PYTHON_PYBIND=y
BR2_PACKAGE_PYTHON_PYGCCXML=y
BR2_PACKAGE_PYTHON_PYZMQ=y
BR2_PACKAGE_PYTHON_SIX=y
BR2_PACKAGE_PYTHON_TYPING_EXTENSIONS=y

BR2_PACKAGE_LOG4CPP=y
BR2_PACKAGE_SPDLOG=y
BR2_PACKAGE_CPPZMQ=y
BR2_PACKAGE_ZEROMQ=y
BR2_PACKAGE_LIBSNDFILE=y
BR2_PACKAGE_PULSEAUDIO_HAS_ATOMIC=y
BR2_PACKAGE_PULSEAUDIO=y 
BR2_PACKAGE_FFTW=y
BR2_PACKAGE_FFTW_SINGLE=y         
BR2_PACKAGE_FFTW_DOUBLE=y
BR2_PACKAGE_FFTW_LONG_DOUBLE=y
BR2_PACKAGE_GMP=y
BR2_PACKAGE_CPPUNIT=y

BR2_PACKAGE_BOOST=y
BR2_PACKAGE_BOOST_LAYOUT_SYSTEM=y
# BR2_PACKAGE_BOOST_LAYOUT_TAGGED is not set
# BR2_PACKAGE_BOOST_LAYOUT_VERSIONED is not set
BR2_PACKAGE_BOOST_LAYOUT="system"
BR2_PACKAGE_BOOST_ATOMIC=y
BR2_PACKAGE_BOOST_CHRONO=y
BR2_PACKAGE_BOOST_CONTAINER=y
BR2_PACKAGE_BOOST_CONTEXT_ARCH_SUPPORTS=y
BR2_PACKAGE_BOOST_CONTEXT=y
BR2_PACKAGE_BOOST_CONTRACT=y
BR2_PACKAGE_BOOST_COROUTINE=y
BR2_PACKAGE_BOOST_DATE_TIME=y
BR2_PACKAGE_BOOST_EXCEPTION=y
BR2_PACKAGE_BOOST_FIBER=y
BR2_PACKAGE_BOOST_FILESYSTEM=y
BR2_PACKAGE_BOOST_GRAPH=y
BR2_PACKAGE_BOOST_GRAPH_PARALLEL=y
BR2_PACKAGE_BOOST_IOSTREAMS=y
BR2_PACKAGE_BOOST_JSON=y
BR2_PACKAGE_BOOST_LOCALE=y
BR2_PACKAGE_BOOST_LOG=y
BR2_PACKAGE_BOOST_MATH=y
BR2_PACKAGE_BOOST_MPI=y
BR2_PACKAGE_BOOST_NOWIDE=y
BR2_PACKAGE_BOOST_PROGRAM_OPTIONS=y
BR2_PACKAGE_BOOST_RANDOM=y
BR2_PACKAGE_BOOST_REGEX=y
BR2_PACKAGE_BOOST_SERIALIZATION=y
BR2_PACKAGE_BOOST_STACKTRACE=y
BR2_PACKAGE_BOOST_SYSTEM=y
BR2_PACKAGE_BOOST_TEST=y
BR2_PACKAGE_BOOST_THREAD=y
BR2_PACKAGE_BOOST_TIMER=y
BR2_PACKAGE_BOOST_TYPE_ERASURE=y
BR2_PACKAGE_BOOST_WAVE=y

BR2_PACKAGE_VOLK=y
BR2_PACKAGE_GNURADIO=y
BR2_PACKAGE_GNURADIO_AUDIO=y
BR2_PACKAGE_GNURADIO_BLOCKS=y
BR2_PACKAGE_GNURADIO_CTRLPORT=y
BR2_PACKAGE_GNURADIO_DTV=y
BR2_PACKAGE_GNURADIO_FEC=y
BR2_PACKAGE_GNURADIO_PYTHON=y
BR2_PACKAGE_GNURADIO_UTILS=y
BR2_PACKAGE_GNURADIO_ZEROMQ=y
BR2_PACKAGE_GNURADIO_ANALOG=y
BR2_PACKAGE_GNURADIO_CHANNELS=y
BR2_PACKAGE_GNURADIO_DIGITAL=y
BR2_PACKAGE_GNURADIO_FFT=y
BR2_PACKAGE_GNURADIO_FILTER=y
BR2_PACKAGE_GNURADIO_TRELLIS=y
BR2_PACKAGE_GNURADIO_UHD=y

BR2_PACKAGE_UHD=y
BR2_PACKAGE_UHD_B100=y
BR2_PACKAGE_UHD_B200=y
BR2_PACKAGE_UHD_E300=y
BR2_PACKAGE_UHD_E320=y
BR2_PACKAGE_UHD_EXAMPLES=n
BR2_PACKAGE_UHD_MPMD=y
BR2_PACKAGE_UHD_N230=y
BR2_PACKAGE_UHD_N300=y
BR2_PACKAGE_UHD_N320=y
BR2_PACKAGE_UHD_OCTOCLOCK=y
BR2_PACKAGE_UHD_PYTHON=n
BR2_PACKAGE_UHD_RFNOC=y
BR2_PACKAGE_UHD_USB=y
BR2_PACKAGE_UHD_USRP1=y
BR2_PACKAGE_UHD_USRP2=y
BR2_PACKAGE_UHD_UTILS=n
BR2_PACKAGE_UHD_X300=y

BR2_PACKAGE_SOAPYSDR=y
BR2_PACKAGE_SOAPYREMOTE=y
BR2_PACKAGE_SOAPYPLUTOSDR=y
BR2_PACKAGE_RETROGRAM=y

BR2_PACKAGE_GR_OSMOSDR=y
BR2_PACKAGE_GR_OSMOSDR_PYTHON=y
BR2_PACKAGE_GR_OSMOSDR_IQFILE=y
BR2_PACKAGE_GR_OSMOSDR_RTLSDR=y
BR2_PACKAGE_GR_OSMOSDR_RTLSDR_TCP=y
# BR2_PACKAGE_GR_OSMOSDR_RFSPACE is not set

BR2_PACKAGE_DUMP1090_PLUTO=y
BR2_PACKAGE_SUSCAN=y
BR2_PACKAGE_TX-TOOLS=y
BR2_PACKAGE_RXTOOLS=y
BR2_PACKAGE_RTLSDR_AIRBAND=y
BR2_PACKAGE_RTL_433=y
BR2_PACKAGE_MULTIMONNG=y
BR2_PACKAGE_SIGUTILS=y
BR2_PACKAGE_LIBFEC=y
BR2_PACKAGE_LIBTUNTAP=y
BR2_PACKAGE_LAME=y
BR2_PACKAGE_LIBSHOUT=y
BR2_PACKAGE_LIBOSMOPLUTOSDR=y
BR2_PACKAGE_CIVETWEBWS=y
BR2_PACKAGE_CIVETWEBWS_SERVER=y
BR2_PACKAGE_CIVETWEBWS_LIB=y
BR2_PACKAGE_LUAJIT=y
BR2_PACKAGE_LUARADIO_BASIC=y
BR2_PACKAGE_CIVETWEBWS_WITH_LUA=y

BR2_PACKAGE_NANO=y
BR2_PACKAGE_SEDUTIL=y
BR2_PACKAGE_GPSD=y
BR2_PACKAGE_GPSD_DEVICES="/dev/ttyUSB0"
BR2_PACKAGE_GPSD_CLIENT_DEBUG=y
BR2_PACKAGE_GPSD_NMEA=y
BR2_PACKAGE_LIBSERIALPORT=y

BR2_PACKAGE_NTP=y
BR2_PACKAGE_NTP_NTPD=y
BR2_PACKAGE_NTP_NTPDATE=y
BR2_PACKAGE_OPENVPN=y
BR2_PACKAGE_OPENVPN_LZ4=y
BR2_PACKAGE_OPENVPN_LZO=y

BR2_PACKAGE_RTAUDIO=y
BR2_PACKAGE_SOX=y
BR2_PACKAGE_WIREGUARD_TOOLS=y
BR2_PACKAGE_MBEDTLS=y
BR2_PACKAGE_OPENSSL=y
BR2_PACKAGE_LIBOPENSSL=y
BR2_PACKAGE_LIBOPENSSL_TARGET_ARCH="linux-armv4"
BR2_PACKAGE_HAS_OPENSSL=y
BR2_PACKAGE_PROVIDES_OPENSSL="libopenssl"
BR2_PACKAGE_PROVIDES_HOST_OPENSSL="host-libopenssl"


BR2_PACKAGE_SDRPP=y
BR2_PACKAGE_LIBGLFW=y
BR2_PACKAGE_LIBGLEW=y 
BR2_PACKAGE_LIBGLU=y
BR2_PACKAGE_LIBXCB=y
BR2_PACKAGE_XLIB_LIBX11=y
BR2_PACKAGE_XLIB_LIBXAU=y
BR2_PACKAGE_XLIB_LIBXCURSOR=y
BR2_PACKAGE_XLIB_LIBXDAMAGE=y
BR2_PACKAGE_XLIB_LIBXDMCP=y
BR2_PACKAGE_XLIB_LIBXEXT=y
BR2_PACKAGE_XLIB_LIBXFIXES=y
BR2_PACKAGE_XLIB_LIBXI=y
BR2_PACKAGE_XLIB_LIBXINERAMA=y
BR2_PACKAGE_XLIB_LIBXRANDR=y
BR2_PACKAGE_XLIB_LIBXRENDER=y
BR2_PACKAGE_XLIB_LIBXXF86VM=y
BR2_PACKAGE_XLIB_XTRANS=y
BR2_PACKAGE_XCB_PROTO=y
BR2_PACKAGE_XORGPROTO=y
BR2_PACKAGE_LIBGLVND=y
BR2_PACKAGE_HAS_LIBGL=y
BR2_PACKAGE_XORG7=y
BR2_PACKAGE_MESA3D=y
BR2_PACKAGE_MESA3D_GALLIUM_DRIVER=y
BR2_PACKAGE_MESA3D_DRIVER=y
BR2_PACKAGE_MESA3D_NEEDS_XA=y
BR2_PACKAGE_MESA3D_NEEDS_X11=y
BR2_PACKAGE_MESA3D_GALLIUM_DRIVER_NOUVEAU=y
BR2_PACKAGE_MESA3D_OPENGL_GLX=y
BR2_PACKAGE_PROVIDES_LIBGL="mesa3d"
BR2_PACKAGE_OPENBLAS_DEFAULT_TARGET="CORTEXA9"
BR2_PACKAGE_OPENBLAS_ARCH_SUPPORTS=y
BR2_PACKAGE_JPEG_SIMD_SUPPORT=y
BR2_PACKAGE_LIBDRM=y
BR2_PACKAGE_LIBDRM_HAS_ATOMIC=y
BR2_PACKAGE_LIBDRM_ENABLE_ATOMIC=y
BR2_PACKAGE_LIBDRM_NOUVEAU=y
BR2_PACKAGE_WAFFLE_SUPPORTS_GLX=y
BR2_PACKAGE_WEBKITGTK_ARCH_SUPPORTS=y
BR2_PACKAGE_WPEWEBKIT_ARCH_SUPPORTS=y
BR2_PACKAGE_CHARON=y
BR2_PACKAGE_FFMPEG=y
BR2_PACKAGE_PULSEAUDIO_DAEMON=y
# BR2_PACKAGE_CSDR=y
```

## patches/sdr/buildroot/package/SoapyPlutoSDR/Config.in
```kconfig
config BR2_PACKAGE_SOAPYPLUTOSDR
        bool "soapyplutosdr"
        select BR2_PACKAGE_SOAPYSDR
        help
          This is a comment that explains what soapysdr is.

          https://github.com/pothosware/SoapyPlutoSDR

        comment "soapyplutosdr needs soapysdr"
                depends on !BR2_PACKAGE_SOAPYSDR
```

## patches/sdr/buildroot/package/SoapyRemote/Config.in
```kconfig
config BR2_PACKAGE_SOAPYREMOTE
        bool "soapyremote"
        select BR2_PACKAGE_SOAPYSDR
        help
          This is a comment that explains what soapysdr is.

          https://github.com/pothosware/SoapyRemote

        comment "soapyremote needs soapysdr"
                depends on !BR2_PACKAGE_SOAPYSDR
```

## patches/sdr/buildroot/package/ad9361/Config.in
```kconfig
config BR2_PACKAGE_AD9361
        bool "ad9361"
        help
          This is a comment that explains what ad9361 is.

          https://github.com/analogdevicesinc/libad9361-iio
```

## patches/sdr/buildroot/package/csdr/Config.in
```kconfig
config BR2_PACKAGE_CSDR
	bool "csdr"
	depends on BR2_TOOLCHAIN_HAS_THREADS
	depends on BR2_PACKAGE_FFTW
#	select BR2_PACKAGE_FFTW
#	select BR2_PACKAGE_FFTW_PRECISION_SINGLE
	help
	 csdr is a command line tool to carry out DSP tasks for Software Defined Radio.

	  https://github.com/simonyiszk/csdr

comment "csdr needs a toolchain w/ threads"
        depends on !BR2_TOOLCHAIN_HAS_THREADS
comment "csdr needs a fftw"
        depends on !BR2_PACKAGE_FFTW
```

## patches/sdr/buildroot/package/retrogram-plutosdr/Config.in
```kconfig
config BR2_PACKAGE_RETROGRAM
        bool "retrogram-plutosdr"
        help
          This is a comment that explains what retrogram is.

          https://github.com/r4d10n/retrogram-plutosdr
```

## patches/sdr/buildroot/package/rtaudio/Config.in
```kconfig
config BR2_PACKAGE_RTAUDIO
	bool "rtaudio"
	help
	  RtAudio

           https://www.music.mcgill.ca/~gary/rtaudio/
```

## patches/sdr/buildroot/package/sdrpp/Config.in
```kconfig
config BR2_PACKAGE_SDRPP
        bool "sdrpp"
        help
          This is a comment that explains what sdrpp is.

          https://github.com/AlexandreRouma/SDRPlusPlus
```

## patches/sdr/buildroot/package/soapysdr/Config.in
```kconfig
config BR2_PACKAGE_SOAPYSDR
        bool "soapysdr"
        help
          This is a comment that explains what soapysdr is.

          https://github.com/pothosware/SoapySDR
```
